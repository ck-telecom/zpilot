## boards/arm/cc3d/Kconfig.board
```kconfig
# cc3d board configuration

# Copyright (c) 2021 gouqs@hotmail.com.
# SPDX-License-Identifier: Apache-2.0

config BOARD_CC3D
	bool "cc3d"
	depends on SOC_STM32F103XB
```

## boards/arm/kite/Kconfig.board
```kconfig
# kite board configuration

# Copyright (c) 2021 gouqs@hotmail.com.
# SPDX-License-Identifier: Apache-2.0

config BOARD_KITE
	bool "kite"
	depends on SOC_STM32F103XB
```

## boards/arm/kite/Kconfig.defconfig
```kconfig
# kite board configuration

# Copyright (c) 2021 gouqs@hotmail.com.
# SPDX-License-Identifier: Apache-2.0

if BOARD_KITE

config BOARD
	default "kite"
endif # BOARD_KITE
```

## boards/arm/kite/kite_defconfig
```kconfig
# SPDX-License-Identifier: Apache-2.0

CONFIG_SOC_SERIES_STM32F1X=y
CONFIG_SOC_STM32F103XB=y

# enable uart driver
CONFIG_SERIAL=y

# enable console
CONFIG_CONSOLE=y
CONFIG_UART_CONSOLE=y

# enable pinmux
CONFIG_PINMUX=y

# enable GPIO
CONFIG_GPIO=y

# Enable Clocks
CONFIG_CLOCK_CONTROL=y

# enable I2C
CONFIG_I2C=y

#enable SPI
CONFIG_SPI=y

CONFIG_PWM=y
CONFIG_PWM_CAPTURE=y
CONFIG_PWM_STM32=y
```

## boards/arm/moon/Kconfig.board
```kconfig
# moon board configuration

# Copyright (c) 2021 gouqs@hotmail.com
# SPDX-License-Identifier: Apache-2.0

config BOARD_MOON
	bool "moon"
	depends on SOC_STM32F103XB
```

## boards/arm/moon/Kconfig.defconfig
```kconfig
# moon board configuration

# Copyright (c) 2021 gouqs@hotmail.com.
# SPDX-License-Identifier: Apache-2.0

if BOARD_MOON

config BOARD
	default "moon"

endif # BOARD_MOON
```

## boards/arm/naze32/Kconfig.board
```kconfig
# cc3d board configuration

# Copyright (c) 2021 gouqs@hotmail.com.
# SPDX-License-Identifier: Apache-2.0

config BOARD_NAZE32
	bool "naze32"
	depends on SOC_STM32F103XB
```

## boards/arm/naze32/Kconfig.defconfig
```kconfig
# kite board configuration

# Copyright (c) 2021 gouqs@hotmail.com.
# SPDX-License-Identifier: Apache-2.0

if BOARD_NAZE32

config BOARD
	default "naze32"
endif # BOARD_NAZE32
```

## drivers/sensor/l3g4200d/zephyr/Kconfig
```kconfig
# L3G4200D gyroscope sensor configuration
# options

# Copyright (c) 2017 Linaro Limited
# SPDX-License-Identifier: Apache-2.0

menuconfig L3G4200D
	bool "L3G4200D I2C/SPI gyroscope Chip"
	depends on I2C || SPI
	help
	  Enable driver for L3G4200D gyroscope sensor.

if L3G4200D

choice L3G4200D_TRIGGER_MODE
	prompt "Trigger mode"
	help
	  Specify the type of triggering to be used by the driver.

config L3G4200D_TRIGGER_NONE
	bool "No trigger"

config L3G4200D_TRIGGER_GLOBAL_THREAD
	bool "Use global thread"
	depends on GPIO
	select L3G4200D_TRIGGER

config L3G4200D_TRIGGER_OWN_THREAD
	bool "Use own thread"
	depends on GPIO
	select L3G4200D_TRIGGER

endchoice

config L3G4200D_TRIGGER
	bool

config L3G4200D_THREAD_PRIORITY
	int "Thread priority"
	depends on L3G4200D_TRIGGER_OWN_THREAD
	default 10
	help
	  Priority of thread used by the driver to handle interrupts.

config L3G4200D_THREAD_STACK_SIZE
	int "Thread stack size"
	depends on L3G4200D_TRIGGER_OWN_THREAD
	default 1024
	help
	  Stack size of thread used by the driver to handle interrupts.

menu "Attributes"

config L3G4200D_GYRO_FS
	int "Gyroscope full-scale range"
	default 250
	help
	  Specify the default gyroscope full-scale range.
	  An X value for the config represents a range of +/- X degree per
	  second. Valid values are 250, 500, 2000

config L3G4200D_GYRO_ODR
	int "Gyroscope Output data rate frequency"
	range 0 10
	default 0
	help
	  Specify the default accelerometer output data rate expressed in
	  samples per second (Hz).
	  0: ODR selected at runtime
	  1: 12.5Hz
	  2: 26Hz
	  3: 52Hz
	  4: 104Hz
	  5: 208Hz
	  6: 416Hz
	  7: 833Hz
	  8: 1660Hz
	  9: 3330Hz
	  10: 6660Hz
endmenu

endif # L3G4200D
```

## drivers/sensor/lsm303dlh/zephyr/Kconfig
```kconfig
# LSM303DLH Three Axis Accelerometer configuration options

# Copyright (c) 2018 Phil��mon Jaermann
# SPDX-License-Identifier: Apache-2.0

menuconfig LSM303DLH_ACCEL
	bool "LSM303DLH Three Axis Accelerometer"
	depends on I2C
	help
	  Enable driver for LSM303DLH I2C-based triaxial accelerometer sensor.

config LSM303DLH_ACCEL_RANGE
	int "Accelerometer measurement range"
	depends on LSM303DLH_ACCEL
	range 0 3
	default 0
	help
	  0: +/- 2g
	  1: +/- 4g
	  2: deprecated
	  3: +/- 8g

config LSM303DLH_ACCEL_ODR
	int "Data rate frequency"
	depends on LSM303DLH_ACCEL
	range 0 3
	default 0
	help
	  0: 50 Hz
	  1: 100 Hz
	  2: 400 Hz
	  3: 100 Hz
```
